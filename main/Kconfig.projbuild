## main/Kconfig.projbuild
```kconfig
menu "Playground Configuration"

config ZERO_DETECT_GPIO
    int "Zero detection GPIO pin"
        range 0 34
	default 34

config ONE_WIRE_GPIO
    int "OneWire GPIO number (dallas)"
	range 0 34
	default 5
	help
		GPIO number (IOxx) to access One Wire Bus.
		Some GPIOs are used for other purposes (flash connections, etc.) and cannot be used
		GPIOs 35-39 are input-only so cannot be used to drive the One Wire Bus.

config ESP_WIFI_SSID
	string "WiFi SSID"
	default "myssid"
	help
		SSID (network name) for the example to connect to.

config ESP_WIFI_PASSWORD
	string "WiFi Password"
	default "mypassword"
	help
		WiFi password (WPA or WPA2) for the example to use.

config ESP_MAXIMUM_RETRY
	int "Maximum retry"
	default 5
	help
		Set the Maximum retry to avoid station reconnecting to the AP unlimited when the AP is really inexistent.
endmenu
```
